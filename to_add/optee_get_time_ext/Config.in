## to_add/optee_get_time_ext/Config.in
```kconfig
config BR2_PACKAGE_OPTEE_GET_TIME_EXT
	bool "optee_get_time"
	help
	  http://github.org/OP-TEE/optee_examples

config BR2_PACKAGE_OPTEE_GET_TIME_EXT_SITE
	string "OP-TEE get_time path"
	default ""
	help
	  The path to the source directory of OP-TEE examples

if BR2_PACKAGE_OPTEE_GET_TIME_EXT

config BR2_PACKAGE_OPTEE_GET_TIME_EXT_SDK
	string "OPTEE SDK path"
	default ""
	help
	  some help

config BR2_PACKAGE_OPTEE_GET_TIME_EXT_CROSS_COMPILE
	string "OPTEE cross compiler"
	default ""
	help
	  some help

endif
```
